#include <NMEAGPS.h>
#include <GPSport.h>
#include <SPI.h>
#include <U8g2lib.h>
#include <RTClib.h>
#include <SHT31.h>
#include <Adafruit_BMP3XX.h>

static NMEAGPS  gps;
static gps_fix  fix;

static const int32_t          zone_hours   = +8L;
static const int32_t          zone_minutes =  0L;
static const NeoGPS::clock_t  zone_offset  = zone_hours * NeoGPS::SECONDS_PER_HOUR + zone_minutes * NeoGPS::SECONDS_PER_MINUTE;
void adjustTime( NeoGPS::time_t & dt )
{
	NeoGPS::clock_t seconds = dt;
	seconds += zone_offset;
	dt = seconds;
}
// 卫星时区调整

RTC_DS3231 rtc;
char daysOfTheWeek[7][12] = {"Sun", "Mon", "Tue", "Wed", "Thu", "Fri", "Sat"};

U8G2_SSD1306_128X64_NONAME_F_4W_HW_SPI u8g2(U8G2_R0, /* cs=*/ PB1, /* dc=*/ PB10, /* reset=*/ PB11);

#define u8g_width 16
#define u8g_height 23
static unsigned char u8g_lstemp_bits[] =
{0x38,0x00,0x44,0x00,0x44,0x02,0x44,0x02,0x44,0x40,0x54,0x27,0x54,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0x7C,0x00};
// 零上图标
static unsigned char u8g_lxtemp_bits[] =
{0x38,0x00,0x44,0x05,0x44,0x53,0x44,0x31,0x44,0x75,0x44,0x09,0x44,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0x7C,0x00};
// 零下图标
static unsigned char u8g_hum_bits[] =
{0x00,0x00,0x00,0x00,0x00,0x00,0x00,0x00,0x00,0x00,0x00,0x00,0x00,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0x00,0x1F};
// 湿度图标
static unsigned char u8g_ap_bits[] =
{0x04,0xF9,0x04,0x81,0x04,0xE1,0x82,0x80,0x82,0xE0,0x82,0x80,0x82,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0x00,0x00};
// 气压图标
static unsigned char u8g_gps1_bits[] =
{0x00,0x02,0x00,0x05,0x80,0x08,0x30,0x04,0x78,0x02,0xF8,0x00,0xF0,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0x00,0x00};
// 有卫星图标
static unsigned char u8g_gps0_bits[] =
{0x00,0x02,0x00,0x05,0x80,0x08,0x30,0x04,0x78,0x02,0xF8,0x00,0xF0,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0x00,0x00};
// 无卫星图标
static unsigned char u8g_sync_bits[] =
{0xC0,0x00,0xF0,0x00,0x38,0x00,0x18,0x00,0x0C,0x30,0x0C,0x78,0x0C,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0x00,0x00};
// 同步成功图标

char ndate [10];
char ntime [16];

SHT31 sht31 = SHT31();

Adafruit_BMP3XX bmp;

int pinBuzzer = PA0;

void oled()
{
	u8g2.clearBuffer();

	if (fix.valid.time && fix.valid.date)
	{
		adjustTime(fix.dateTime);
	}
// 时区

	if (fix.valid.status)
	{
		if (fix.status <= gps_fix::STATUS_TIME_ONLY)
		{
			u8g2.drawXBMP( 112, 0, u8g_width, u8g_height, u8g_gps0_bits);
		}
		else
		{
			u8g2.drawXBMP( 112, 0, u8g_width, u8g_height, u8g_gps1_bits);
		}
		if (fix.status >= 3 && fix.valid.time && fix.valid.date)
		{

			rtc.adjust(DateTime(fix.dateTime.full_year(), fix.dateTime.month, fix.dateTime.date, fix.dateTime.hours, fix.dateTime.minutes, fix.dateTime.seconds));
			u8g2.drawXBMP( 94, 0, u8g_width, u8g_height, u8g_sync_bits);
			tone(pinBuzzer,8400,125);
		}
	}
// 卫星检测与校时

	DateTime now = rtc.now();
	sprintf(ndate,"%02u-%02u",now.month(),now.day());
	u8g2.setFont(u8g2_font_6x12_tf);
	u8g2.setCursor(34,50);
	u8g2.print( ndate );
	u8g2.print( "  " );
	u8g2.print( daysOfTheWeek[now.dayOfTheWeek()] );
// 星期

	if (sht31.getTemperature() > 0)
	{
		u8g2.drawXBMP( 0, 41, u8g_width, u8g_height, u8g_lstemp_bits);
	}
	else
	{
		u8g2.drawXBMP( 0, 41, u8g_width, u8g_height, u8g_lxtemp_bits);
	}
	u8g2.drawXBMP( 112, 41, u8g_width, u8g_height, u8g_hum_bits);
	char du = 0xb0;
	u8g2.setCursor(11,64);
	u8g2.print( sht31.getTemperature() );
	u8g2.print( du );
	u8g2.print( "C" );
	u8g2.setCursor(78,64);
	u8g2.print( sht31.getHumidity() );
	u8g2.print( "%" );
// 温湿度

	bmp.performReading();
	u8g2.drawXBMP( 0, 0, u8g_width, u8g_height, u8g_ap_bits);
	u8g2.setCursor(18,13);
	u8g2.print( bmp.pressure / 100 );
	u8g2.print( "hPa" );
// 气压

	sprintf(ntime,"%02u:%02u:%02u",now.hour(),now.minute(),now.second());
	u8g2.setFont(u8g2_font_logisoso24_tn);
	u8g2.setCursor(8,40);
	u8g2.print(ntime);
// 时间

	u8g2.sendBuffer();
}

void setup()
{
	gpsPort.begin(9600);
	u8g2.begin();
	rtc.begin();
	sht31.begin();
	bmp.begin();
	bmp.setPressureOversampling(BMP3_OVERSAMPLING_4X);
	bmp.setIIRFilterCoeff(BMP3_IIR_FILTER_COEFF_3);
	pinMode(pinBuzzer, OUTPUT);
	SPI.begin(); //Initialize the SPI_1 port.
	SPI.setClockDivider(SPI_CLOCK_DIV16);
}

static void GPSloop()
{
	while (gps.available(gpsPort))
	{
		fix = gps.read();
		oled();
	}
}

void loop()
{
	GPSloop();
}